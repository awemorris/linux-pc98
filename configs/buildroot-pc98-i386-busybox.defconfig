## configs/buildroot-pc98-i386-busybox.defconfig
```kconfig
BR2_x86_i386=y
BR2_KERNEL_HEADERS_7_0=y
BR2_TOOLCHAIN_BUILDROOT_MUSL=y
BR2_BINUTILS_VERSION_2_45_X=y
BR2_GCC_VERSION_14_X=y
BR2_STATIC_LIBS=y
BR2_TARGET_OPTIMIZATION="-Os -fcf-protection=none"
# BR2_USE_WCHAR is not set
# BR2_ENABLE_LOCALE is not set
BR2_INIT_BUSYBOX=y
BR2_TARGET_ENABLE_ROOT_LOGIN=y
BR2_TARGET_GENERIC_ROOT_PASSWD=""
BR2_TARGET_GENERIC_GETTY_PORT="ttyS0"
BR2_SYSTEM_DHCP=""
BR2_TARGET_ROOTFS_TAR=y
```
